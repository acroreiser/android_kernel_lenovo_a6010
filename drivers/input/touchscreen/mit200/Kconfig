## drivers/input/touchscreen/mit200/Kconfig
```kconfig
#
# Touchscreen driver configuration
#

if INPUT_TOUCHSCREEN

config TOUCHSCREEN_MIT200
        tristate "MELFAS MIT200 Touchscreen"
        depends on I2C
        help
          Say Y here if you have a MELFAS MIT200 touchscreen device in your system.

          If unsure, say N.

          To compile this driver as a module, choose M here: the module will be called mit_ts.

endif
```

## drivers/input/touchscreen/mms200/Kconfig
```kconfig
#
# Touchscreen driver configuration
#
menuconfig INPUT_TOUCHSCREEN
	bool "Touchscreens"
	help
	  Say Y here, and a list of supported touchscreens will be displayed.
	  This option doesn't affect the kernel.

	  If unsure, say Y.

if INPUT_TOUCHSCREEN

config TOUCHSCREEN_MMS200
        tristate "MELFAS MMS-series touchscreen"
        depends on I2C
        help
          Say Y here if you have a MELFAS MMS-series touchscreen controller
          chip in your system.

          If unsure, say N.

          To compile this driver as a module, choose M here: the
          module will be called mms200_ts.

endif
```
