## arch/arm/mach-msm/lge/Kconfig
```kconfig
config MACH_LGE
	bool

menu "LGE Board Selection"

config MACH_DORY
	depends on ARCH_MSM8226
	select MACH_LGE
	bool "APQ8026 DORY"
	help
	  Support for the LGE APQ8026 DORY.

config MACH_MSM8974_HAMMERHEAD
	depends on ARCH_MSM8974
	select MACH_LGE
	bool "MSM8974 HAMMERHEAD"
	help
	  Support for the LGE MSM8974 HAMMERHEAD.

config LGE_BLUETOOTH
	bool "Support LGE Bluetooth"
	depends on BT
	help
	  Support for the LGE Bluetooth
endmenu
```

## drivers/platform/lenovo/Kconfig
```kconfig
# Lenovo configuration options

config MACH_LENOVO
	bool "Wingtech device"
	depends on ARCH_MSM
	help
	  Support for Lenovo products

config MACH_LENOVO_MSM8916
	bool "Lenovo MSM8916"
	depends on ARCH_MSM8916
	select MACH_LENOVO
	help
	  Support for MSM8916 Lenovo variants

menu "Lenovo board selection"

config MACH_WT86518
	bool "WT86518 board"
	select MACH_LENOVO_MSM8916
	help
	  Support for Lenovo A6000(s) variant

choice
	prompt "Lenovo device model"

config MACH_LENOVO_A6000
        bool "Lenovo A6000"
        help
          Support for Lenovo A6000

config MACH_LENOVO_A6010
        bool "Lenovo A6010"
        help
          Support for Lenovo A6010

config MACH_SISLEYR
        bool "Lenovo S90-A"
        help
          Support for Lenovo S90-A

endchoice

endmenu
```

## drivers/switch/Kconfig
```kconfig
menuconfig SWITCH
	tristate "Switch class support"
	help
	  Say Y here to enable switch class support. This allows
	  monitoring switches by userspace via sysfs and uevent.

if SWITCH

config SWITCH_GPIO
	tristate "GPIO Swith support"
	depends on GPIOLIB
	help
	  Say Y here to enable GPIO based switch support.

config SWITCH_ARIZONA
	tristate "Wolfson Arizona Switch support"
	depends on MFD_ARIZONA && INPUT && SND_SOC
	help
	  Say Y here to enable support for external accessory detection
	  with Wolfson Arizona devices. These are audio CODECs with
	  advanced audio accessory detection support.

config SWITCH_MAX1462X
	tristate "MAXIM Headset detection driver(MAX14628)"
	default n
	help
	  Say Y here to enable max1462x switch support. This works
	  as earjack detection switch and reduces popup noise.

endif # SWITCH
```
