/* Copyright (c) 2013, The Linux Foundation. All rights reserved.
 *
 * This program is free software; you can redistribute it and/or modify
 * it under the terms of the GNU General Public License version 2 and
 * only version 2 as published by the Free Software Foundation.
 *
 * This program is distributed in the hope that it will be useful,
 * but WITHOUT ANY WARRANTY; without even the implied warranty of
 * MERCHANTABILITY or FITNESS FOR A PARTICULAR PURPOSE.  See the
 * GNU General Public License for more details.
 */

/*---------------------------------------------------------------------------
 * This file is autogenerated file using gcdb parser. Please do not edit it.
 * Update input XML file to add a new entry or update variable in this file
 * VERSION = "1.0"
 *---------------------------------------------------------------------------*/
&mdss_mdp {
	dsi_ili9881_qimei_720p_video: qcom,mdss_dsi_ili9881_qimei_720p_video {
		qcom,mdss-dsi-panel-name = "ili9881_qimei_HD720p_video_Yassy";
		qcom,mdss-dsi-panel-controller = <&mdss_dsi0>;
		qcom,mdss-dsi-panel-type = "dsi_video_mode";
		qcom,mdss-dsi-panel-destination = "display_1";
		qcom,mdss-dsi-panel-framerate = <60>;
		qcom,mdss-dsi-virtual-channel-id = <0>;
		qcom,mdss-dsi-stream = <0>;
		qcom,mdss-dsi-panel-width = <720>;
		qcom,mdss-dsi-panel-height = <1280>;
		qcom,mdss-dsi-h-front-porch = <168>;
		qcom,mdss-dsi-h-back-porch = <240>;
		qcom,mdss-dsi-h-pulse-width = <24>;
		qcom,mdss-dsi-h-sync-skew = <0>;
		qcom,mdss-dsi-v-back-porch = <20>;
		qcom,mdss-dsi-v-front-porch = <12>;
		qcom,mdss-dsi-v-pulse-width = <4>;
		qcom,mdss-dsi-h-left-border = <0>;
		qcom,mdss-dsi-h-right-border = <0>;
		qcom,mdss-dsi-v-top-border = <0>;
		qcom,mdss-dsi-v-bottom-border = <0>;
		qcom,mdss-dsi-bpp = <24>;
		qcom,mdss-dsi-color-order = "rgb_swap_rgb";
		qcom,mdss-dsi-underflow-color = <0xff>;
		qcom,mdss-dsi-border-color = <0>;
		qcom,mdss-dsi-on-command = [39 01 00 00 00 00 04 FF 98 81 07
    39 01 00 00 00 00 02 03 21
    39 01 00 00 00 00 02 04 06
    39 01 00 00 00 00 02 05 00
    39 01 00 00 00 00 02 06 00
    39 01 00 00 00 00 02 07 00
    39 01 00 00 00 00 02 08 04
    39 01 00 00 00 00 02 09 00
    39 01 00 00 00 00 02 0A 04
    39 01 00 00 00 00 02 0B 03
    39 01 00 00 00 00 02 0C 03
    39 01 00 00 00 00 02 0D 00
    39 01 00 00 00 00 02 0E 00
    39 01 00 00 00 00 02 0F 00
    39 01 00 00 00 00 02 10 40
    39 01 00 00 00 00 02 11 04
    39 01 00 00 00 00 02 12 0B
    39 01 00 00 00 00 02 13 00
    39 01 00 00 00 00 02 14 00
    39 01 00 00 00 00 02 15 00
    39 01 00 00 00 00 02 16 04
    39 01 00 00 00 00 02 17 04
    39 01 00 00 00 00 02 18 00
    39 01 00 00 00 00 02 19 00
    39 01 00 00 00 00 02 1A 00
    39 01 00 00 00 00 02 1B 54
    39 01 00 00 00 00 02 1C BB
    39 01 00 00 00 00 02 1D 3C
    39 01 00 00 00 00 02 1E 04
    39 01 00 00 00 00 02 1F 00
    39 01 00 00 00 00 02 20 00
    39 01 00 00 00 00 02 21 00
    39 01 00 00 00 00 02 22 00
    39 01 00 00 00 00 02 23 C0
    39 01 00 00 00 00 02 24 50
    39 01 00 00 00 00 02 25 00
    39 01 00 00 00 00 02 26 08
    39 01 00 00 00 00 02 27 05
    39 01 00 00 00 00 02 30 01
    39 01 00 00 00 00 02 31 23
    39 01 00 00 00 00 02 32 45
    39 01 00 00 00 00 02 33 67
    39 01 00 00 00 00 02 34 89
    39 01 00 00 00 00 02 35 ab
    39 01 00 00 00 00 02 36 01
    39 01 00 00 00 00 02 37 23
    39 01 00 00 00 00 02 38 45
    39 01 00 00 00 00 02 39 67
    39 01 00 00 00 00 02 3A 89
    39 01 00 00 00 00 02 3B ab
    39 01 00 00 00 00 02 3C cd
    39 01 00 00 00 00 02 3D ef
    39 01 00 00 00 00 02 50 01
    39 01 00 00 00 00 02 51 14
    39 01 00 00 00 00 02 52 15
    39 01 00 00 00 00 02 53 0c
    39 01 00 00 00 00 02 54 0d
    39 01 00 00 00 00 02 55 0e
    39 01 00 00 00 00 02 56 0F
    39 01 00 00 00 00 02 57 10
    39 01 00 00 00 00 02 58 11
    39 01 00 00 00 00 02 59 08
    39 01 00 00 00 00 02 5A 02
    39 01 00 00 00 00 02 5B 0A
    39 01 00 00 00 00 02 5C 02
    39 01 00 00 00 00 02 5D 02
    39 01 00 00 00 00 02 5E 02
    39 01 00 00 00 00 02 5F 02
    39 01 00 00 00 00 02 60 02
    39 01 00 00 00 00 02 61 02
    39 01 00 00 00 00 02 62 02
    39 01 00 00 00 00 02 63 02
    39 01 00 00 00 00 02 64 06
    39 01 00 00 00 00 02 65 02
    39 01 00 00 00 00 02 66 02
    39 01 00 00 00 00 02 67 14
    39 01 00 00 00 00 02 68 15
    39 01 00 00 00 00 02 69 11
    39 01 00 00 00 00 02 6A 10
    39 01 00 00 00 00 02 6B 0f
    39 01 00 00 00 00 02 6C 0E
    39 01 00 00 00 00 02 6D 0D
    39 01 00 00 00 00 02 6E 0C
    39 01 00 00 00 00 02 6F 06
    39 01 00 00 00 00 02 70 02
    39 01 00 00 00 00 02 71 0a
    39 01 00 00 00 00 02 72 02
    39 01 00 00 00 00 02 73 02
    39 01 00 00 00 00 02 74 02
    39 01 00 00 00 00 02 75 02
    39 01 00 00 00 00 02 76 02
    39 01 00 00 00 00 02 77 02
    39 01 00 00 00 00 02 78 02
    39 01 00 00 00 00 02 79 02
    39 01 00 00 00 00 02 7A 08
    39 01 00 00 00 00 02 7B 02
    39 01 00 00 00 00 02 7C 02
    39 01 00 00 00 00 04 FF 98 81 08
    39 01 00 00 00 00 02 1F 75
    39 01 00 00 00 00 02 AB 74
    39 01 00 00 00 00 02 5D 4C
    39 01 00 00 00 00 02 8A C0
    39 01 00 00 00 00 02 E4 E0
    39 01 00 00 00 00 02 76 D4              
    39 01 00 00 00 00 02 78 02              
    39 01 00 00 00 00 02 74 3B		
    39 01 00 00 00 00 02 8E 15		
    39 01 00 00 00 00 02 40 01		
    39 01 00 00 00 00 02 7B 04
    39 01 00 00 00 00 02 72 25
    39 01 00 00 00 00 02 87 3A
//    39 01 00 00 00 00 02 7E 4C
    39 01 00 00 00 00 02 6C 05
    39 01 00 00 00 00 02 49 10
    39 01 00 00 00 00 02 2D 80
    39 01 00 00 00 00 02 32 05
    39 01 00 00 00 00 02 3C 05
    39 01 00 00 00 00 04 FF 98 81 01
    39 01 00 00 00 00 02 41 32
    39 01 00 00 00 00 02 42 07
    39 01 00 00 00 00 02 35 07
    39 01 00 00 00 00 02 22 0A		
    39 01 00 00 00 00 02 31 00		
    39 01 00 00 00 00 02 53 81	
    39 01 00 00 00 00 02 55 88		
    39 01 00 00 00 00 02 50 A3         	
    39 01 00 00 00 00 02 51 A3         	
    39 01 00 00 00 00 02 60 30         	
    39 01 00 00 00 00 02 A0 00		
    39 01 00 00 00 00 02 A1 20                     
    39 01 00 00 00 00 02 A2 2C                     
    39 01 00 00 00 00 02 A3 18                      
    39 01 00 00 00 00 02 A4 1B      
    39 01 00 00 00 00 02 A5 2E 
    39 01 00 00 00 00 02 A6 20
    39 01 00 00 00 00 02 A7 21                   
    39 01 00 00 00 00 02 A8 88                   
    39 01 00 00 00 00 02 A9 1F                   
    39 01 00 00 00 00 02 AA 2A                     
    39 01 00 00 00 00 02 AB 6D                        
    39 01 00 00 00 00 02 AC 1B                       
    39 01 00 00 00 00 02 AD 1A                       
    39 01 00 00 00 00 02 AE 4F                      
    39 01 00 00 00 00 02 AF 24                    
    39 01 00 00 00 00 02 B0 27                       
    39 01 00 00 00 00 02 B1 43                       
    39 01 00 00 00 00 02 B2 56                    
    39 01 00 00 00 00 02 B3 3F                                                             
    39 01 00 00 00 00 02 C0 00		
    39 01 00 00 00 00 02 C1 22                     
    39 01 00 00 00 00 02 C2 32                       
    39 01 00 00 00 00 02 C3 12                   
    39 01 00 00 00 00 02 C4 14                   
    39 01 00 00 00 00 02 C5 27                   
    39 01 00 00 00 00 02 C6 1B                    
    39 01 00 00 00 00 02 C7 1D       
    39 01 00 00 00 00 02 C8 8D     
    39 01 00 00 00 00 02 C9 1A                     
    39 01 00 00 00 00 02 CA 26                     
    39 01 00 00 00 00 02 CB 7A                      
    39 01 00 00 00 00 02 CC 19                       
    39 01 00 00 00 00 02 CD 18                        
    39 01 00 00 00 00 02 CE 4C                      
    39 01 00 00 00 00 02 CF 20                       
    39 01 00 00 00 00 02 D0 28                       
    39 01 00 00 00 00 02 D1 51                        
    39 01 00 00 00 00 02 D2 5C                     
    39 01 00 00 00 00 02 D3 3F               
    39 01 00 00 00 00 04 FF 98 81 00
 //   39 01 00 00 00 00 02 35 00   
  //  39 01 00 00 00 00 02 51 08   
  //  39 01 00 00 00 00 02 53 2c
  //  39 01 00 00 00 00 02 55 00
    05 01 00 00 78 00 02 11 00           
    05 01 00 00 0a 00 02 29 00];
		qcom,mdss-dsi-off-command = [05 01 00 00 0a 00 02 28 00
					05 01 00 00 8c 00 02 10 00];
		qcom,mdss-dsi-on-command-state = "dsi_lp_mode";
		qcom,mdss-dsi-off-command-state = "dsi_hs_mode";
		qcom,mdss-dsi-h-sync-pulse = <1>;
		qcom,mdss-dsi-traffic-mode = "burst_mode";
		qcom,mdss-dsi-bllp-eof-power-mode;
		qcom,mdss-dsi-bllp-power-mode;
		qcom,mdss-dsi-lane-map = "lane_map_0123";
		qcom,mdss-dsi-lane-0-state;
		qcom,mdss-dsi-lane-1-state;
		qcom,mdss-dsi-lane-2-state;
		qcom,mdss-dsi-lane-3-state;
		qcom,mdss-dsi-hfp-power-mode;
		qcom,mdss-dsi-hbp-power-mode;
		qcom,mdss-dsi-hsa-power-mode;
		qcom,esd-check-enabled; 
		qcom,mdss-dsi-panel-status-command-num = <1>;
		qcom,mdss-dsi-panel-status-command1 = [06 01 00 01 05 00 02 0A 08];
		qcom,mdss-dsi-panel-status-command-state = "dsi_lp_mode";
		qcom,mdss-dsi-panel-status-check-mode = "reg_read"; 
		qcom,mdss-dsi-panel-status-value1 = <1 0x9c>; 
		qcom,mdss-dsi-panel-timings = [98 22 16 00 4A 4E 1A 26 1A 03 04 00];
		qcom,mdss-dsi-t-clk-post = <0x04>;
		qcom,mdss-dsi-t-clk-pre = <0x1E>;
		qcom,mdss-dsi-bl-min-level = <1>;
		qcom,mdss-dsi-bl-max-level = <255>;
		qcom,mdss-dsi-bl-pmic-pwm-frequency = <100>;
		qcom,mdss-dsi-bl-pmic-bank-select = <0>;
		qcom,mdss-dsi-dma-trigger = "trigger_sw";
		qcom,mdss-dsi-mdp-trigger = "none";
		qcom,mdss-dsi-bl-pmic-control-type = "bl_ctrl_pwm";

		qcom,mdss-dsi-reset-sequence = <1 5>, <0 5>, <1 30>;
		qcom,mdss-pan-physical-width-dimension = <59>;
		qcom,mdss-pan-physical-height-dimension = <104>;
	};
};
