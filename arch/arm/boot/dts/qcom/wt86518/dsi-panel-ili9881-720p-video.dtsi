/* Copyright (c) 2013, The Linux Foundation. All rights reserved.
 *
 * This program is free software; you can redistribute it and/or modify
 * it under the terms of the GNU General Public License version 2 and
 * only version 2 as published by the Free Software Foundation.
 *
 * This program is distributed in the hope that it will be useful,
 * but WITHOUT ANY WARRANTY; without even the implied warranty of
 * MERCHANTABILITY or FITNESS FOR A PARTICULAR PURPOSE.  See the
 * GNU General Public License for more details.
 */

/*---------------------------------------------------------------------------
 * This file is autogenerated file using gcdb parser. Please do not edit it.
 * Update input XML file to add a new entry or update variable in this file
 * VERSION = "1.0"
 *---------------------------------------------------------------------------*/
&mdss_mdp {
	dsi_ili9881_720p_video: qcom,mdss_dsi_ili9881_720p_video {
		qcom,mdss-dsi-panel-name = "ili9881_HD720p_video_Yassy";
		qcom,mdss-dsi-panel-controller = <&mdss_dsi0>;
		qcom,mdss-dsi-panel-type = "dsi_video_mode";
		qcom,mdss-dsi-panel-destination = "display_1";
		qcom,mdss-dsi-panel-framerate = <60>;
		qcom,mdss-dsi-virtual-channel-id = <0>;
		qcom,mdss-dsi-stream = <0>;
		qcom,mdss-dsi-panel-width = <720>;
		qcom,mdss-dsi-panel-height = <1280>;
		qcom,mdss-dsi-h-front-porch = <168>;
		qcom,mdss-dsi-h-back-porch = <240>;
		qcom,mdss-dsi-h-pulse-width = <24>;
		qcom,mdss-dsi-h-sync-skew = <0>;
		qcom,mdss-dsi-v-back-porch = <20>;
		qcom,mdss-dsi-v-front-porch = <12>;
		qcom,mdss-dsi-v-pulse-width = <4>;
		qcom,mdss-dsi-h-left-border = <0>;
		qcom,mdss-dsi-h-right-border = <0>;
		qcom,mdss-dsi-v-top-border = <0>;
		qcom,mdss-dsi-v-bottom-border = <0>;
		qcom,mdss-dsi-bpp = <24>;
		qcom,mdss-dsi-color-order = "rgb_swap_rgb";
		qcom,mdss-dsi-underflow-color = <0xff>;
		qcom,mdss-dsi-border-color = <0>;
		qcom,mdss-dsi-on-command = [39 01 00 00 00 00 04 FF 98 81 07
	39 01 00 00 00 00 02 03 20 
	39 01 00 00 00 00 02 04 06
	39 01 00 00 00 00 02 05 00
	39 01 00 00 00 00 02 06 01
	39 01 00 00 00 00 02 07 00
	39 01 00 00 00 00 02 08 00
	39 01 00 00 00 00 02 09 00
	39 01 00 00 00 00 02 0A 00
	39 01 00 00 00 00 02 0B 2F
	39 01 00 00 00 00 02 0C 00
	39 01 00 00 00 00 02 0D 00
	39 01 00 00 00 00 02 0E 00
	39 01 00 00 00 00 02 0F 00
	39 01 00 00 00 00 02 10 40
	39 01 00 00 00 00 02 11 02
	39 01 00 00 00 00 02 12 05
	39 01 00 00 00 00 02 13 90 //
	39 01 00 00 00 00 02 14 02 //
	39 01 00 00 00 00 02 15 00
	39 01 00 00 00 00 02 16 2F
	39 01 00 00 00 00 02 17 2F
	39 01 00 00 00 00 02 18 00
	39 01 00 00 00 00 02 19 00
	39 01 00 00 00 00 02 1A 00
	39 01 00 00 00 00 02 1B 50
	39 01 00 00 00 00 02 1C 2C //
	39 01 00 00 00 00 02 1D 0C
	39 01 00 00 00 00 02 1E 00
	39 01 00 00 00 00 02 1F 87 //
	39 01 00 00 00 00 02 20 86 //
	39 01 00 00 00 00 02 21 00
	39 01 00 00 00 00 02 22 00
	39 01 00 00 00 00 02 23 C0
	39 01 00 00 00 00 02 24 30
	39 01 00 00 00 00 02 25 00
	39 01 00 00 00 00 02 26 00
	39 01 00 00 00 00 02 27 03
	39 01 00 00 00 00 02 30 01
	39 01 00 00 00 00 02 31 23
	39 01 00 00 00 00 02 32 45
	39 01 00 00 00 00 02 33 67
	39 01 00 00 00 00 02 34 89
	39 01 00 00 00 00 02 35 AB
	39 01 00 00 00 00 02 36 01
	39 01 00 00 00 00 02 37 23
	39 01 00 00 00 00 02 38 45
	39 01 00 00 00 00 02 39 67
	39 01 00 00 00 00 02 3A 89
	39 01 00 00 00 00 02 3B AB
	39 01 00 00 00 00 02 3C CD
	39 01 00 00 00 00 02 3D EF	
	39 01 00 00 00 00 02 50 11
	39 01 00 00 00 00 02 51 06
	39 01 00 00 00 00 02 52 0c
	39 01 00 00 00 00 02 53 0d
	39 01 00 00 00 00 02 54 0e
	39 01 00 00 00 00 02 55 0f
	39 01 00 00 00 00 02 56 02
	39 01 00 00 00 00 02 57 02
	39 01 00 00 00 00 02 58 02
	39 01 00 00 00 00 02 59 02
	39 01 00 00 00 00 02 5A 02
	39 01 00 00 00 00 02 5B 02
	39 01 00 00 00 00 02 5C 02
	39 01 00 00 00 00 02 5D 02
	39 01 00 00 00 00 02 5E 02
	39 01 00 00 00 00 02 5F 02
	39 01 00 00 00 00 02 60 05
	39 01 00 00 00 00 02 61 05
	39 01 00 00 00 00 02 62 05
	39 01 00 00 00 00 02 63 02
	39 01 00 00 00 00 02 64 01
	39 01 00 00 00 00 02 65 00
	39 01 00 00 00 00 02 66 08
	39 01 00 00 00 00 02 67 08
	39 01 00 00 00 00 02 68 0C
	39 01 00 00 00 00 02 69 0D
	39 01 00 00 00 00 02 6A 0E
	39 01 00 00 00 00 02 6B 0F
	39 01 00 00 00 00 02 6C 02
	39 01 00 00 00 00 02 6D 02
	39 01 00 00 00 00 02 6E 02
	39 01 00 00 00 00 02 6F 02
	39 01 00 00 00 00 02 70 02
	39 01 00 00 00 00 02 71 02
	39 01 00 00 00 00 02 72 02
	39 01 00 00 00 00 02 73 02
	39 01 00 00 00 00 02 74 02
	39 01 00 00 00 00 02 75 02
	39 01 00 00 00 00 02 76 05
	39 01 00 00 00 00 02 77 05
	39 01 00 00 00 00 02 78 05
	39 01 00 00 00 00 02 79 02
	39 01 00 00 00 00 02 7A 01
	39 01 00 00 00 00 02 7B 00
	39 01 00 00 00 00 02 7C 06
	39 01 00 00 00 00 04 FF 98 81 08
	39 01 00 00 00 00 02 76 B4		
	39 01 00 00 00 00 02 78 02		
	39 01 00 00 00 00 02 74 2B		
	39 01 00 00 00 00 02 8E 15		
	39 01 00 00 00 00 02 40 01		
	39 01 00 00 00 00 02 7B 04
	39 01 00 00 00 00 02 72 25
	39 01 00 00 00 00 02 87 3A
	39 01 00 00 00 00 02 7E 4C
	39 01 00 00 00 00 02 6C 05
	39 01 00 00 00 00 02 49 10
	39 01 00 00 00 00 02 2D 80
	39 01 00 00 00 00 02 50 65
	39 01 00 00 00 00 02 53 29
	39 01 00 00 00 00 02 54 65
	39 01 00 00 00 00 02 55 38
	39 01 00 00 00 00 02 57 47
	39 01 00 00 00 00 02 58 47
	39 01 00 00 00 00 04 FF 98 81 01
	39 01 00 00 00 00 02 22 0A		
	39 01 00 00 00 00 02 53 91		
	39 01 00 00 00 00 02 55 78		
	39 01 00 00 00 00 02 50 A5 //
	39 01 00 00 00 00 02 51 A2 //
	39 01 00 00 00 00 02 31 00		
	39 01 00 00 00 00 02 A0 0A		
	39 01 00 00 00 00 02 A1 1F
	39 01 00 00 00 00 02 A2 2E
	39 01 00 00 00 00 02 A3 16
	39 01 00 00 00 00 02 A4 1B
	39 01 00 00 00 00 02 A5 27
	39 01 00 00 00 00 02 A6 1F
	39 01 00 00 00 00 02 A7 1E
	39 01 00 00 00 00 02 A8 94
	39 01 00 00 00 00 02 A9 1E
	39 01 00 00 00 00 02 AA 2B
	39 01 00 00 00 00 02 AB 93
	39 01 00 00 00 00 02 AC 1e
	39 01 00 00 00 00 02 AD 1D
	39 01 00 00 00 00 02 AE 53
	39 01 00 00 00 00 02 AF 26
	39 01 00 00 00 00 02 B0 2d
	39 01 00 00 00 00 02 B1 55
	39 01 00 00 00 00 02 B2 68
	39 01 00 00 00 00 02 B3 3F              
	39 01 00 00 00 00 02 C0 01		
	39 01 00 00 00 00 02 C1 0F
	39 01 00 00 00 00 02 C2 19
	39 01 00 00 00 00 02 C3 16
	39 01 00 00 00 00 02 C4 14               
	39 01 00 00 00 00 02 C5 25               
	39 01 00 00 00 00 02 C6 15
	39 01 00 00 00 00 02 C7 1C
	39 01 00 00 00 00 02 C8 78
	39 01 00 00 00 00 02 C9 1D
	39 01 00 00 00 00 02 CA 28
	39 01 00 00 00 00 02 CB 6A
	39 01 00 00 00 00 02 CC 1c
	39 01 00 00 00 00 02 CD 1A
	39 01 00 00 00 00 02 CE 4C
	39 01 00 00 00 00 02 CF 1F
	39 01 00 00 00 00 02 D0 25
	39 01 00 00 00 00 02 D1 54
	39 01 00 00 00 00 02 D2 62
	39 01 00 00 00 00 02 D3 3F
	39 01 00 00 00 00 04 FF 98 81 06
	39 01 00 00 00 00 02 1B 02
	39 01 00 00 00 00 02 5A 03
	39 01 00 00 00 00 02 1A 06
	39 01 00 00 00 00 02 20 09
	39 01 00 00 00 00 02 21 0C
	39 01 00 00 00 00 02 22 0F              
	39 01 00 00 00 00 04 FF 98 81 00
	39 01 00 00 00 00 02 55 80
	37 01 00 00 00 00 02 01 00
	05 01 00 00 78 00 02 11 00 
	05 01 00 00 0A 00 02 29 00];
		qcom,mdss-dsi-off-command = [05 01 00 00 14 00 02 28 00
					05 01 00 00 78 00 02 10 00];
		qcom,mdss-dsi-on-command-state = "dsi_lp_mode";
		qcom,mdss-dsi-off-command-state = "dsi_hs_mode";
		qcom,mdss-dsi-h-sync-pulse = <1>;
		qcom,mdss-dsi-traffic-mode = "burst_mode";
		qcom,mdss-dsi-bllp-eof-power-mode;
		qcom,mdss-dsi-bllp-power-mode;
		qcom,mdss-dsi-lane-map = "lane_map_0123";
		qcom,mdss-dsi-lane-0-state;
		qcom,mdss-dsi-lane-1-state;
		qcom,mdss-dsi-lane-2-state;
		qcom,mdss-dsi-lane-3-state;
		qcom,mdss-dsi-hfp-power-mode;
		qcom,mdss-dsi-hbp-power-mode;
		qcom,mdss-dsi-hsa-power-mode;
		qcom,esd-check-enabled; 
		qcom,mdss-dsi-panel-status-command-num = <1>;
		qcom,mdss-dsi-panel-status-command1 = [06 01 00 01 05 00 02 0A 08];
		qcom,mdss-dsi-panel-status-command-state = "dsi_lp_mode";
		qcom,mdss-dsi-panel-status-check-mode = "reg_read"; 
		qcom,mdss-dsi-panel-status-value1 = <1 0x9c>; 
		qcom,mdss-dsi-panel-timings = [98 22 16 00 4A 4E 1A 26 1A 03 04 00];
		qcom,mdss-dsi-t-clk-post = <0x04>;
		qcom,mdss-dsi-t-clk-pre = <0x1E>;
		qcom,mdss-dsi-bl-min-level = <1>;
		qcom,mdss-dsi-bl-max-level = <255>;
		qcom,mdss-dsi-bl-pmic-pwm-frequency = <100>;
		qcom,mdss-dsi-bl-pmic-bank-select = <0>;
		qcom,mdss-dsi-dma-trigger = "trigger_sw";
		qcom,mdss-dsi-mdp-trigger = "none";
		qcom,mdss-dsi-bl-pmic-control-type = "bl_ctrl_pwm";

		qcom,mdss-dsi-reset-sequence = <1 5>, <0 5>, <1 30>;
		qcom,mdss-pan-physical-width-dimension = <59>;
		qcom,mdss-pan-physical-height-dimension = <104>;
	};
};
